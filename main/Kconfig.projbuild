## main/Kconfig.projbuild
```kconfig
menu "HMI Board Config"
    choice NOSSAT_BOARD
        default NOSSAT_ONE_BOARD
        prompt "Select HMI Board"
        config NOSSAT_BOX_LITE_BOARD
            bool "Nosyna Satellite Box Lite"
        config NOSSAT_ONE_BOARD
            bool "Nosyna Satellite One"
    endchoice

    config NOSSAT_SPEECH_RECOGNITION
        bool "Enable Speech Recognition"
        default "y"

    config NOSSAT_LVGL_GUI
        bool "Enable LVGL GUI"
        default "y"
endmenu
```

## sdkconfig.defaults.nossat_one
```kconfig
CONFIG_NOSSAT_ONE_BOARD=y
CONFIG_NOSSAT_SPEECH_RECOGNITION=y

CONFIG_ESP32S3_DATA_CACHE_64KB=y
CONFIG_ESP32S3_DATA_CACHE_LINE_64B=y
CONFIG_ESP32S3_DEFAULT_CPU_FREQ_240=y
CONFIG_ESP32S3_INSTRUCTION_CACHE_32KB=y
CONFIG_ESP32S3_SPIRAM_SUPPORT=y
CONFIG_ESP32_S3_KORVO2_V3_BOARD=y
CONFIG_ESPTOOLPY_FLASHMODE_QIO=y
CONFIG_ESPTOOLPY_FLASHSIZE_16MB=y
CONFIG_ESP_SYSTEM_ALLOW_RTC_FAST_MEM_AS_HEAP=y
CONFIG_ESP_SYSTEM_PANIC_PRINT_REBOOT=y
CONFIG_ESP_SYSTEM_RTC_FAST_MEM_AS_HEAP_DEPCHECK=y
CONFIG_IDF_CMAKE=y
CONFIG_IDF_FIRMWARE_CHIP_ID=0x0009
CONFIG_IDF_TARGET="esp32s3"
CONFIG_IDF_TARGET_ARCH_XTENSA=y
CONFIG_IDF_TARGET_ESP32S3=y
CONFIG_MODEL_IN_SPIFFS=y
CONFIG_PARTITION_TABLE_CUSTOM=y
CONFIG_PARTITION_TABLE_CUSTOM_FILENAME="partitions.csv"
CONFIG_PARTITION_TABLE_FILENAME="partitions.csv"
CONFIG_PARTITION_TABLE_OFFSET=0x8000
CONFIG_SDK_TOOLPREFIX="xtensa-esp32s3-elf-"
CONFIG_SPIRAM_MODE_OCT=y
CONFIG_SPIRAM_SPEED_80M=y
CONFIG_SR_MN_CN_NONE=y
CONFIG_SR_MN_ENGLISH=y
CONFIG_SR_MN_EN_MULTINET7_QUANT=y
CONFIG_SR_WN_WN9_ALEXA=y
CONFIG_USE_MULTINET=y
CONFIG_USE_WAKENET=y
CONFIG_PM_ENABLE=n
CONFIG_PM_POWER_DOWN_CPU_IN_LIGHT_SLEEP=n
CONFIG_PM_POWER_DOWN_TAGMEM_IN_LIGHT_SLEEP=n
```
